## boards/shields/marble/Kconfig.defconfig
```kconfig
if SHIELD_MARBLE_LEFT

config ZMK_KEYBOARD_NAME
    default "marble"

config ZMK_SPLIT_ROLE_CENTRAL
    default y

endif # SHIELD_MARBLE_LEFT

if SHIELD_MARBLE_LEFT || SHIELD_MARBLE_RIGHT

config ZMK_SPLIT
    default y

endif # SHIELD_MARBLE_LEFT || SHIELD_MARBLE_RIGHT
```

## boards/shields/marble/Kconfig.shield
```kconfig
config SHIELD_MARBLE_LEFT
    def_bool $(shields_list_contains,marble_left)

config SHIELD_MARBLE_RIGHT
    def_bool $(shields_list_contains,marble_right)
```
