#include "marble.dtsi"

&kscan0 {
    // Replace these comments with the GPIO pins in the matrix for the left side.
    // See https://zmk.dev/docs/development/hardware-integration/new-shield#shield-overlays
};
