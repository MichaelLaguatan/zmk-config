#include "marble.dtsi"

&default_transform {
    // Set this to the number of columns on the left side.
    col-offset = <6>;
};

&kscan0 {
    // Replace these comments with the GPIO pins in the matrix for the right side.
    // See https://zmk.dev/docs/development/hardware-integration/new-shield#shield-overlays
};
